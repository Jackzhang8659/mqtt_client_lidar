// These arguments were used when this file was generated. They will be automatically applied on subsequent loads 
// via the GUI or CLI invocations. Run CLI with '--help' for additional information on how to override these arguments.
// @cliArgs --board "/ti/boards/CC3220SF_LAUNCHXL" --product "simplelink_cc32xx_sdk@3.40.00.05"
// @versions {"data":"2020022712","timestamp":"2020022712","tool":"1.3.1030","templates":"2020022712"}

var SimpleLinkWifi = scripting.addModule("/ti/drivers/net/wifi/SimpleLinkWifi");
var Crypto = scripting.addModule("/ti/drivers/Crypto");
var Crypto1 = Crypto.addInstance();
var Power = scripting.addModule("/ti/drivers/Power");
var Board = scripting.addModule("/ti/drivers/Board");
var DriverLib = scripting.addModule("/ti/devices/DriverLib");
var Display = scripting.addModule("/ti/display/Display");
var Display1 = Display.addInstance();
var UART = scripting.addModule("/ti/drivers/UART", {}, false);
var DMA = scripting.addModule("/ti/drivers/DMA");
var GPIO = scripting.addModule("/ti/drivers/GPIO");
var GPIO1 = GPIO.addInstance();
var GPIO2 = GPIO.addInstance();
var GPIO3 = GPIO.addInstance();
var GPIO4 = GPIO.addInstance();
var GPIO5 = GPIO.addInstance();
var GPIO6 = GPIO.addInstance();
var GPIO7 = GPIO.addInstance();
var GPIO8 = GPIO.addInstance();
var SPI = scripting.addModule("/ti/drivers/SPI");
var Timer = scripting.addModule("/ti/drivers/Timer");
var Timer1 = Timer.addInstance();
var Watchdog = scripting.addModule("/ti/drivers/Watchdog");
var Watchdog1 = Watchdog.addInstance();
var SlNet = scripting.addModule("/ti/net/SlNet");
var SlNet1 = SlNet.addInstance();
var UART1 = UART.addInstance();
var PWM = scripting.addModule("/ti/drivers/PWM", {}, false);
var PWM1 = PWM.addInstance();
// Name - The C/C++ identifier used in applications as the index parameter passed to Crypto runtime APIs
Crypto1.$name = "CONFIG_Crypto_0";
// IO Retention Shutdown - IO groups to be retained during Shutdown
Power.ioRetentionShutdown = ["GRP_1"];
// Name
Power.parkPins.$name = "ti_drivers_power_PowerCC32XXPins0";
// Name - The C/C++ identifier used in applications as the index parameter passed to Display runtime APIs
Display1.$name = "CONFIG_Display_0";
// Use Hardware - Select the hardware to use, or 'None' to use available header pins
Display1.$hardware = system.deviceData.board.components.XDS110UART;
// Name - The C/C++ identifier used in applications as the index parameter passed to UART runtime APIs
Display1.uart.$name = "CONFIG_UART_0";
// Use DMA
Display1.uart.useDMA = true;
// Name
Display1.uart.uart.$name = "MyUART1";
// Use Peripheral
Display1.uart.uart.$assign = "UART0";
// Assign pin
Display1.uart.uart.txPin.$assign = "GP01"; // pin number - 55
// Assign pin
Display1.uart.uart.rxPin.$assign = "GP02"; // pin number - 57
// Assign pin
Display1.uart.uart.txDmaChannel.$assign = "UDMA_CH9";
// Assign pin
Display1.uart.uart.rxDmaChannel.$assign = "UDMA_CH8";
// Use Hardware - Select the hardware to use, or 'None' to use available header pins
GPIO1.$hardware = system.deviceData.board.components.SW2;
// Name - The C/C++ identifier used in applications as the index parameter passed to GPIO runtime APIs
GPIO1.$name = "CONFIG_GPIO_BUTTON_0";
// Assign pin
GPIO1.gpioPin.$assign = "boosterpack.3"; // P04
// Use Hardware - Select the hardware to use, or 'None' to use available header pins
GPIO2.$hardware = system.deviceData.board.components.SW3;
// Name - The C/C++ identifier used in applications as the index parameter passed to GPIO runtime APIs
GPIO2.$name = "CONFIG_GPIO_BUTTON_1";
// Assign pin
GPIO2.gpioPin.$assign = "boosterpack.11"; // P15
// Use Hardware - Select the hardware to use, or 'None' to use available header pins
GPIO3.$hardware = system.deviceData.board.components.LED_RED;
// Output Strength - Specifies the output strength
GPIO3.outputStrength = "High";
// Name - The C/C++ identifier used in applications as the index parameter passed to GPIO runtime APIs
GPIO3.$name = "CONFIG_GPIO_LED_0";
// Use Hardware - Select the hardware to use, or 'None' to use available header pins
GPIO4.$hardware = system.deviceData.board.components.LED_YELLOW;
// Output Strength - Specifies the output strength
GPIO4.outputStrength = "High";
// Name - The C/C++ identifier used in applications as the index parameter passed to GPIO runtime APIs
GPIO4.$name = "CONFIG_GPIO_LED_1";
// Use Hardware - Select the hardware to use, or 'None' to use available header pins
GPIO5.$hardware = system.deviceData.board.components.LED_GREEN;
// Output Strength - Specifies the output strength
GPIO5.outputStrength = "High";
// Name - The C/C++ identifier used in applications as the index parameter passed to GPIO runtime APIs
GPIO5.$name = "CONFIG_GPIO_LED_2";
// Name - The C/C++ identifier used in applications as the index parameter passed to GPIO runtime APIs
GPIO6.$name = "CONFIG_GPIO_0";
// Mode - Select the GPIO mode
GPIO6.mode = "Dynamic";
// Assign pin
GPIO6.gpioPin.$assign = "boosterpack.19"; // P18
// Name - The C/C++ identifier used in applications as the index parameter passed to GPIO runtime APIs
GPIO7.$name = "CONFIG_GPIO_1";
// Mode - Select the GPIO mode
GPIO7.mode = "Dynamic";
// Assign pin
GPIO7.gpioPin.$assign = "boosterpack.5"; // P61
// Name - The C/C++ identifier used in applications as the index parameter passed to GPIO runtime APIs
GPIO8.$name = "CONFIG_GPIO_2";
// Mode - Select the GPIO mode
GPIO8.mode = "Dynamic";
// Assign pin
GPIO8.gpioPin.$assign = "boosterpack.4"; // P03
// Name - The C/C++ identifier used in applications as the index parameter passed to Timer runtime APIs
Timer1.$name = "CONFIG_TIMER_0";
// Timer Type
Timer1.timerType = "32 Bits";
// Name
Timer1.timer.$name = "MyTimer1";
// Use Peripheral
Timer1.timer.$assign = "Timer0";
// Name - The C/C++ identifier used in applications as the index parameter passed to Watchdog runtime APIs
Watchdog1.$name = "CONFIG_WATCHDOG_0";
// Name
Watchdog1.watchdog.$name = "MyWATCHDOG1";
// Use Peripheral
Watchdog1.watchdog.$assign = "WATCHDOG0";
// Name
SlNet1.$name = "CONFIG_SLNET";
// Interface Name - Specifies the name for this interface"
SlNet1.ifName = "CC32xx";
// Name - The C/C++ identifier used in applications as the index parameter passed to UART runtime APIs
UART1.$name = "CONFIG_UART_1";
// Ring Buffer Size - Number of bytes in the ring buffer
UART1.ringBufferSize = 3500;
// Name
UART1.uart.$name = "MyUART1";
// Use Peripheral
UART1.uart.$assign = "UART1";
// Assign pin
UART1.uart.txPin.$assign = "boosterpack.15"; // P07
// Assign pin
UART1.uart.rxPin.$assign = "boosterpack.18"; // P08
// Name - The C/C++ identifier used in applications as the index parameter passed to PWM runtime APIs
PWM1.$name = "CONFIG_PWM_0";
// Name
PWM1.timer.$name = "MyTimer1";
// Use Peripheral
PWM1.timer.$assign = "Timer1";
// Assign pin
PWM1.timer.pwmPin.$assign = "boosterpack.13"; // P21
// Suggest solution
GPIO3.gpioPin.$suggestSolution = "64";
// Suggest solution
GPIO4.gpioPin.$suggestSolution = "1";
// Suggest solution
GPIO5.gpioPin.$suggestSolution = "2";
